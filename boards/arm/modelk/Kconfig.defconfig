## boards/arm/modelk/Kconfig.defconfig
```kconfig
if BOARD_MODELK

config ZMK_KEYBOARD_NAME
    default "ModelK"

config ZMK_SLEEP
    default n

config ZMK_BLE_PASSKEY_ENTRY
    default y

config EC11
    default y

config EC11_TRIGGER_GLOBAL_THREAD
    default y

endif
```

## config/west.yml
```yaml
manifest:
  remotes:
    - name: zmkfirmware
      url-base: https://github.com/zmkfirmware
    - name: elpekenin
      url-base: https://github.com/elpekenin
    - name: urob
      url-base: https://github.com/urob
  projects:
    - name: zmk
      remote: zmkfirmware
      revision: v0.2.1
      import: app/west.yml

    - name: zmk-userspace
      remote: elpekenin
      revision: e7989299ac59f1f56ab5fb99a1422c0e94bafdb7
    - name: zmk-leader-key
      remote: urob
      revision: v0.2.1
  self:
    path: config
```
